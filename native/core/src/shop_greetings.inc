// Generated from shoppe-greetings.ts and shop-tables.ts.
static constexpr const char * BLACKSMITH_BUY_ASKS[]={"Wouldst thou buy one?","Wilt thou take it?","Wish ye it?","May I get one for thee?"};
static constexpr const char * BLACKSMITH_BUY_BROKE[]={"Can't pay?! Out with ye, orc-face!","What be ye trying to pull? OUT!","OUT, SLIME!","BEAT IT!"};
static constexpr const char * BLACKSMITH_BUY_EXCLAIMS[]={"Very good!\n","Excellent!\n","Fine, fine!\n","But of course!\n"};
static constexpr const char * BLACKSMITH_BUY_INTROS[]={"We have:","We stock:","Thou canst buy:","We've got:"};
static constexpr int32_t BLACKSMITH_BUY_PITCH_INDEX[]={8,9,10,11,12,13,14,15,-1,16,17,18,19,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48,-1};
static constexpr const char * BLACKSMITH_BUY_WHICH[]={"What may I show thee?","Which wouldst thou like to see?","What is thine interest?","Which would ye see?"};
static constexpr const char * BLACKSMITH_SELL_BYES[]={"Good-bye...","Mayhap another time...","Godspeed...","Fare thee well..."};
static constexpr const char * BLACKSMITH_SELL_MORE[]={"What else can ye offer me?","What else hath ye to sell?","What else doth thou wish to sell?","What other arms wilt thou sell?"};
static constexpr int32_t BLACKSMITH_SELL_OFFER_INDEX[]={49,50,51,52,53,54,55,56};
static constexpr const char * BLACKSMITH_SELL_PROMPTS[]={"Which item wouldst thou like to sell?","What dost thou wish to sell?","Show me what ye got...","What dost thou have for me to buy?"};
static constexpr int32_t GUILD_BROKE_INDEX=163;
static constexpr int32_t GUILD_EASTEREGG_INDEX=164;
static constexpr int32_t GUILD_PITCH_INDEX[]={160,161,162};
static constexpr int32_t HEALER_SORRY_INDEX=173;
static constexpr int32_t HORSE_PITCH_INDEX=104;
static constexpr int32_t INN_ALONE_INDEX=191;
static constexpr int32_t INN_CORPSE_INDEX=192;
static constexpr int32_t INN_PICKUP_BROKE_INDEX=193;
static constexpr int32_t INN_PITCH_INDEX[]={186,187,188,188,189,190};
static constexpr int32_t MAGIC_SELLER_BROKE_INDEX=147;
static constexpr int32_t MAGIC_SELLER_PITCH_INDEX[]={139,140,141,142,143,144,145,146};
static constexpr int32_t SHIP_CHEAT_INDEX=122;
static constexpr int32_t SHIP_ELSE_INDEX=124;
static constexpr int32_t SHIP_MENU_INDEX=119;
static constexpr int32_t SHIP_PITCH_FRIGATE_INDEX=117;
static constexpr int32_t SHIP_PITCH_SKIFF_INDEX=118;
static constexpr int32_t SHIP_SOLD_INDEX=123;
static constexpr int32_t SHIP_TAKE_INDEX=126;
static constexpr int32_t SHOPPE_FAREWELL_NO_PURCHASE[8][4]={{0,1,2,3},{61,62,63,64},{96,97,98,99},{109,110,111,112},{131,132,133,134},{152,153,154,155},{169,170,171,172},{178,179,180,181}};
static constexpr int32_t SHOPPE_FAREWELL_PURCHASE[8][4]={{4,5,6,7},{65,66,67,68},{100,101,102,103},{113,114,115,116},{135,136,137,138},{156,157,158,159},{169,170,171,172},{182,183,184,185}};
static constexpr int32_t SHOPPE_GREETING_INDEX[8][4]={{-1,-1,-1,-1},{57,58,59,60},{92,93,94,95},{105,106,107,108},{127,128,129,130},{148,149,150,151},{165,166,167,168},{174,175,176,177}};
static constexpr int32_t TAVERN_MEAGRE_INDEX=89;
static constexpr int32_t TAVERN_MENU_INDEX[]={69,70,71,72};
static constexpr int32_t TAVERN_MENU_REVISIT_INDEX[]={73,74,75,76};
static constexpr int32_t TAVERN_RATIONS_PITCH_INDEX[]={77,78,79,80,81,82,83};
static constexpr int32_t TAVERN_SCRAPS_INDEX=90;
static constexpr int32_t TAVERN_SUBTYPE[]={0,0,0,2,3,1,0,2,0};
static constexpr int32_t TAVERN_SUBTYPE_WINE=1;
static constexpr int32_t DRUNK_CUP_GATE=3;
static constexpr int32_t DRUNK_TIMER_TURNS=25;
static constexpr int32_t FRIGATE_PRICES[]={600,753,650,700};
static constexpr int32_t GUILD_GRANT[]={3,4,5};
static constexpr int32_t HORSE_PRICES[]={100,130,160,190};
static constexpr int32_t INN_CAPACITY[]={3,4,3,2,2,2};
static constexpr int32_t INN_RATE[]={2,3,2,3,2,3};
static constexpr int32_t INN_ROOM_X[]={21,15,25,20,27,7};
static constexpr int32_t INN_ROOM_Y[]={10,7,9,1,6,26};
static constexpr int32_t RATION_BASE[]={10,15,20,25,30,25,20,25,30};
static constexpr int32_t RATION_FOOD_PER_UNIT=25;
static constexpr int32_t RUMOR_BROKE_INDEX=91;
static constexpr int32_t RUMOR_FORM_INDEX[]={85,86,87,88};
static constexpr int32_t RUMOR_GOSSIP_MAP[]={0,1,2,3,4,5,6,7,0,1,2,3,4,5,7,1,3,9,11,10,12,0,4,10,1,8};
static constexpr const char * RUMOR_KEYWORDS[]={"hone","comp","valo","just","sacr","hono","spir","humi","dece","desp","dest","wron","cove","sham","hyth","crow","scep","amul","fals","hatr","cowa","astr","oppr","brit","resi","unde"};
static constexpr const char * RUMOR_PLACES[]={"Moonglow","Britain","Jhelom","Yew","Minoc","Trinsic","Skara Brae","New Magincia","a lighthouse south of Britain","a hidden mountain keep","the desert","the Lycaeum","Serpent's Hold"};
static constexpr int32_t RUMOR_PRICES[]={50,75,50,50,75,75,25,50,100,150,75,150,75,100,100,200,200,200,250,250,250,100,50,50,200,100};
static constexpr int32_t RUMOR_PRICE_PITCH_INDEX=84;
static constexpr const char * RUMOR_SUBJECTS[]={"Malik","Greyson","Trian","Jeremy","Rew","Gruman","Saul","Shirita","Malifora","Annon","Trian","Felespar","the mother of Rew","Sindar","Kaiko","Terrance","Greymarch","Simon and Tessa","Shalineth","a daemon","Lord Malone","Zachariah","Tactus","a daemon","Terrance","Jotham"};
static constexpr int32_t SHIP_DOCK_X[]={39,151,79,138};
static constexpr int32_t SHIP_DOCK_Y[]={221,21,109,159};
static constexpr int32_t SHIP_REPLACEMENT_PRICE=10000;
static constexpr int32_t SKIFF_PRICES[]={200,175,125,100};
static constexpr int32_t TAVERN_ROUND_PRICE[]={3,4,5,3,2,5,3,4,5};
static constexpr const char * WINE_MENU_LINES[]={"a) Rose.......18\n","b) Claret....192\n","c) Sauterne...79\n","d) Muscatel...30\n","e) Moselle...275\n","f) Chablis....98\n\n"};
static constexpr const char * WINE_NAMES[]={"Rose","Claret","Sauterne","Muscatel","Moselle","Chablis"};
static constexpr int32_t WINE_PRICES[]={18,192,79,30,275,98};
