// Generated from authoritative TypeScript by generate-shop-tables.ts.
static constexpr int32_t GUILD_PRICES[][3] = {{190,255,12},{160,200,11},{185,225,25},{170,150,20}};
static constexpr int32_t GUILD_GRANT[] = {3,4,5};
static constexpr int32_t HORSE_PRICES[] = {100,130,160,190};
static constexpr int32_t FRIGATE_PRICES[] = {600,753,650,700};
static constexpr int32_t SKIFF_PRICES[] = {200,175,125,100};
static constexpr int32_t SHIP_DOCK_X[] = {39,151,79,138};
static constexpr int32_t SHIP_DOCK_Y[] = {221,21,109,159};
static constexpr int32_t TAVERN_ROUND_PRICE[] = {3,4,5,3,2,5,3,4,5};
static constexpr int32_t WINE_PRICES[] = {18,192,79,30,275,98};
static constexpr int32_t RATION_BASE[] = {10,15,20,25,30,25,20,25,30};
static constexpr int32_t INN_RATE[] = {2,3,2,3,2,3};
static constexpr int32_t INN_CAPACITY[] = {3,4,3,2,2,2};
static constexpr int32_t INN_ROOM_X[] = {21,15,25,20,27,7};
static constexpr int32_t INN_ROOM_Y[] = {10,7,9,1,6,26};
static constexpr int32_t RUMOR_PRICES[] = {50,75,50,50,75,75,25,50,100,150,75,150,75,100,100,200,200,200,250,250,250,100,50,50,200,100};
static constexpr const char * RUMOR_KEYWORDS[] = {"hone","comp","valo","just","sacr","hono","spir","humi","dece","desp","dest","wron","cove","sham","hyth","crow","scep","amul","fals","hatr","cowa","astr","oppr","brit","resi","unde"};
static constexpr const char * RUMOR_SUBJECTS[] = {"Malik","Greyson","Trian","Jeremy","Rew","Gruman","Saul","Shirita","Malifora","Annon","Trian","Felespar","the mother of Rew","Sindar","Kaiko","Terrance","Greymarch","Simon and Tessa","Shalineth","a daemon","Lord Malone","Zachariah","Tactus","a daemon","Terrance","Jotham"};
static constexpr int32_t RUMOR_GOSSIP_MAP[] = {0,1,2,3,4,5,6,7,0,1,2,3,4,5,7,1,3,9,11,10,12,0,4,10,1,8};
static constexpr const char * RUMOR_PLACES[] = {"Moonglow","Britain","Jhelom","Yew","Minoc","Trinsic","Skara Brae","New Magincia","a lighthouse south of Britain","a hidden mountain keep","the desert","the Lycaeum","Serpent's Hold"};
static constexpr int32_t towns_Blacksmith[] = {2,3,4,5,6,17,24,26,32};
static constexpr int32_t towns_Barkeeper[] = {1,2,3,4,8,19,22,24,30};
static constexpr int32_t towns_HorseSeller[] = {6,20,22,30};
static constexpr int32_t towns_Shipwright[] = {3,5,21,24};
static constexpr int32_t towns_MagicSeller[] = {1,4,7,23,30};
static constexpr int32_t towns_GuildMaster[] = {8,22,24};
static constexpr int32_t towns_Healer[] = {5,6,7,21,23,30,31};
static constexpr int32_t towns_InnKeeper[] = {2,3,7,20,22,24};
static constexpr const char *msg_blacksmith = "Wouldst thou Buy or Sell?";
static constexpr const char *msg_guild = "Buy Keys, Gems, or Torches?";
static constexpr const char *msg_healer = "\"We have powers to Cure, Heal, or Resurrect.\"";
static constexpr const char *msg_healerSays = "says {}.";
static constexpr const char *msg_inn = "Rest, Leave, or Pick up a companion?";
static constexpr const char *msg_reagentsSell = "Yes\n\n\"Fine! We sell:\n\n";
static constexpr const char *msg_reagentNo = "No";
static constexpr const char *msg_reagentInterest = "\nThy interest?\" ";
static constexpr const char *msg_horse = "A fine steed! Art thou interested?";
static constexpr const char *msg_ship = "Frigate or Skiff?";
static constexpr const char *msg_whom = "For whom?";
static constexpr const char *msg_buyEcho = "Buy\n\n\"";
static constexpr const char *msg_buyNo = "No\n\n";
static constexpr const char *msg_buyYes = "Yes\n";
static constexpr const char *msg_buyFull = "\n\"Thou canst not carry any more!\"\n";
static constexpr const char *msg_buyFullSays = "says $.\n\n";
static constexpr const char *msg_buyBrokeOpen = "\n\"";
static constexpr const char *msg_buyBrokeYells = "\"\nyells $.\n";
static constexpr const char *msg_buySold = "\nSold!\n";
static constexpr const char *msg_buyAnythingElse = "\"Anything else,\n";
static constexpr const char *msg_buyThen = "then?";
static constexpr const char *msg_buySir = "sir?";
static constexpr const char *msg_buyMilady = "milady?";
static constexpr const char *msg_sellEcho = "Sell\n\n\"";
static constexpr const char *msg_sellQuoteClose = "\" ";
static constexpr const char *msg_sellByeClose = "\"\n";
static constexpr const char *msg_sellDealPrompt = "\n\nDeal?\" ";
static constexpr const char *msg_sellDealYes = "Yes\n\n\"Done!\"\nsays $.";
static constexpr const char *msg_sellAmmo = "\n\n\"We don't deal in used ammunition!\"\ngrowls $.\n";
static constexpr const char *msg_sellCannotBuy = "That, I cannot buy from thee.\"\nsays $.";
static constexpr const char *msg_sellNothing = "Thou hast nothing to sell!\"\ngrowls $.\n";
static constexpr const char *msg_farewell = "Come again!";
static constexpr const char *msg_farewellQuoteOpen = "\n\n\"";
static constexpr const char *msg_blacksmithWelcome = "\"Good @, and welcome to #!\"";
static constexpr const char *msg_blacksmithSays = "\n$ says,\n\"";
static constexpr const char *msg_blacksmithAsk1 = "Hail, friend! Wouldst thou Buy or Sell?\" ";
static constexpr const char *msg_blacksmithAsk2 = "Greetings, traveller! Wish ye to Buy, or hast thou wares to Sell?\" ";
static constexpr const char *msg_greetQuoteOpen = "\"";
static constexpr const char *msg_reagentNeed = " Is this thy need?\" ";
static constexpr const char *msg_reagentDealNo = "No\n\n\"What else?\n\n";
static constexpr const char *msg_reagentThanks = "\n\"I thank thee!\"\nsays $.\n";
static constexpr const char *msg_reagentAnythingElse = "\"Anything else?\n\n";
static constexpr const char *msg_reagentFull = "\n\n\"Thou canst not carry any more!\"\n\n";
static constexpr const char *msg_guildYes = "Yes\n\n\"We sell:\n\n";
static constexpr const char *msg_guildRowKeys = "a.........Keys\n";
static constexpr const char *msg_guildRowGems = "b.........Gems\n";
static constexpr const char *msg_guildRowTorches = "c......Torches\n\n";
static constexpr const char *msg_guildConcern = "Thy concern?\" ";
static constexpr const char *msg_guildInterested = "\n\nInterested?\" ";
static constexpr const char *msg_guildDealNo = "No\n\n\"What else, then?\n\n";
static constexpr const char *msg_guildSold = "\n\"Sold!\"\nsays $.\n\n\"What else, \n";
static constexpr const char *msg_guildMlady = "m'lady";
static constexpr const char *msg_guildMlord = "m'lord";
static constexpr const char *msg_guildQtail = "?\n\n";
static constexpr const char *msg_stablesClosed = "The stables are closed.\n";
static constexpr const char *msg_horseYesOpen = "Yes\n\n\"";
static constexpr const char *msg_horseYesExcl = "Yes!";
static constexpr const char *msg_horseBroke = "\n\n\"Thou couldst not afford to feed it!\"\nyells $.\n";
static constexpr const char *msg_healerGateYes = "Yes\n\n";
static constexpr const char *msg_healerSaysNature = "says $.\n\n\"What is the nature of thy need?\" ";
static constexpr const char *msg_healerCuring = "Curing";
static constexpr const char *msg_healerHealing = "Healing";
static constexpr const char *msg_healerResurrectEcho = "Resurrect";
static constexpr const char *msg_healerNothing = "Nothing";
static constexpr const char *msg_healerWho = "\n\n\"Who needs my aid?\" ";
static constexpr const char *msg_healerNoOne = "No one";
static constexpr const char *msg_healerNoNeed = "\n\n\"Thou hast no need of this art!\"\nsays $.";
static constexpr const char *msg_healerLight = "Receive now the Light!\"";
static constexpr const char *msg_healerCurePitch = "I can cure thy poisoned body ";
static constexpr const char *msg_healerHealPitch = "I can heal thee ";
static constexpr const char *msg_healerResPitch = "I can raise this unfortunate person from the dead ";
static constexpr const char *msg_healerPay = "for % gold.\n\nWilt thou\npay?\" ";
static constexpr const char *msg_healerPayYes = "Yes";
static constexpr const char *msg_healerAnyOther = "\n\n\"Is there any other way in which I may\naid thee?\" ";
static constexpr const char *msg_tavernYesOpen = "Yes\n\n\"";
static constexpr const char *msg_wineEnjoy = "\nEnjoy!\"";
static constexpr const char *msg_drunkPardon = "\n\n\"I beg thy\npardon, ";
static constexpr const char *msg_drunkSays = ",\"\nsays ";
static constexpr const char *msg_drunkEnough = ".\n\"But haven't\nye had enough\nto drink?\" ";
static constexpr const char *msg_drunkYes = "Yes\n\n";
static constexpr const char *msg_drunkNo = "No!";
static constexpr const char *msg_wineListOpen = "\"Our wine list,\n";
static constexpr const char *msg_wineListAfterName = ".\n\n";
static constexpr const char *msg_wineThyChoice = "Thy choice?\" ";
static constexpr const char *msg_wineFineChoice = "\n\n\"Ah, a fine\nchoice, ";
static constexpr const char *msg_wineCantPay = "\"\n\n\"CAN'T PAY?\nBeat it!\"\nyells ";
static constexpr const char *msg_tavernThatWillBe = "That will be ";
static constexpr const char *msg_tavernGoldForThe = " gold for the ";
static constexpr const char *msg_tavernOfYe = " of ye,\n";
static constexpr const char *msg_tavernSir = "sir";
static constexpr const char *msg_tavernMilady = "milady";
static constexpr const char *msg_tavernPriceClose = ".";
static constexpr const char *msg_roundEnjoy = "\nEnjoy!\"\n\n";
static constexpr const char *msg_tavernHowMany = "\n\nHow many wouldst\nthou like?\" ";
static constexpr const char *msg_tavernHrumph = "\n\n\"Hrumph.\"";
static constexpr const char *msg_tavernNoNeed = "\"Thou hast\nneither gold nor\nneed! Out!\"\n";
static constexpr const char *msg_tavernYells = "yells ";
static constexpr const char *msg_tavernAffordOnly = "\"Thou canst\nafford only ";
static constexpr const char *msg_tavernAffordClose = "!\"\n\n";
static constexpr const char *msg_tavernAnythingElse = "\"Anything else\nfor thee?\" ";
static constexpr const char *msg_rumorAskOpen = "\n\n\"";
static constexpr const char *msg_rumorAsk = "Of what wouldst\nthou hear my\nlore, ";
static constexpr const char *msg_rumorRespond = "?\"\n\nYou respond:\n";
static constexpr const char *msg_rumorAfterInput = "\n\n";
static constexpr const char *msg_rumorUnknown = "\"That, I cannot help thee with.\n\n";
static constexpr const char *msg_rumorFairNuff = "\n\nFair 'nuff?\" ";
static constexpr const char *msg_rumorNo = "No\n\n";
static constexpr const char *msg_rumorYes = "Yes\n\n";
static constexpr const char *msg_rumorSorry = "\"Sorry, ";
static constexpr const char *msg_rumorSays = "\nsays ";
static constexpr const char *msg_rumorSaysClose = ".\n\n";
static constexpr const char *msg_shipYes = "Yes";
static constexpr const char *msg_shipEchoF = "F\n\n";
static constexpr const char *msg_shipEchoS = "S\n\n";
static constexpr const char *msg_shipTakeYes = "Yes\n\n";
static constexpr const char *msg_shipYells = "yells $.\n";
static constexpr const char *msg_shipElseClose = "?\" ";
static constexpr const char *msg_innYes = "Yes";
static constexpr const char *msg_innMenu = "\n\n$ asks,\n\"Art thou here\nto Pick up or\nLeave a\ncompanion, or\nto Rest for the\nnight?\" ";
static constexpr const char *msg_innMore = "\"Is there\nanything more\nI can do for\nthee?\" ";
static constexpr const char *msg_innSorry = "\"I am sorry,\n";
static constexpr const char *msg_innMilady = "milady";
static constexpr const char *msg_innSir = "sir";
static constexpr const char *msg_innSorryClose = ", but we\nhave no room\navailable.\"\n\n";
static constexpr const char *msg_innWiltTake = "\nWilt thou take\nit?\" ";
static constexpr const char *msg_innBroke = "\"Highwaymen!\nCheap, at that!\nOUT!\" ";
static constexpr const char *msg_innBrokeScreams = "screams\n$.\n";
static constexpr const char *msg_innPleasant = "\"Have a pleasant\nnight, ";
static constexpr const char *msg_innPleasantClose = "!\"\nsays $.\n\n";
static constexpr const char *msg_innZzz = "Zzzzzz....\n\n";
static constexpr const char *msg_innMorning = "Morning!\n";
static constexpr const char *msg_innPassedAway = " has\npassed away.\n";
static constexpr const char *msg_innWhoStay = "$ asks,\n\"Who will\nstay?\" ";
static constexpr const char *msg_innNobody = "Nobody\n\n";
static constexpr const char *msg_innFriendWont = "Thy friend will not leave thee!\n\n";
static constexpr const char *msg_innFriendsWont = "Thy friends will not leave thee!\n\n";
static constexpr const char *msg_innRateOpen = "\"The rate for\nour most comfortable room will be ";
static constexpr const char *msg_innRateMonthly = "% gold per month, due at check-out.";
static constexpr const char *msg_innThank = "\"I thank thee.\"\nsays $.\n\n";
static constexpr const char *msg_innPickupFull = "\n\nOne must first be left behind!\n\n";
static constexpr const char *msg_innPickupNobody = "\n\n\"No one here is from thy party!\"\nsays $.\n\n";
static constexpr const char *msg_innWhoCheckOut = "\n\n\"Who will\ncheck out?\" ";
static constexpr const char *msg_innPickupNoOne = "No one\n\n";
static constexpr const char *msg_innPickupPay = "\n\n\"That will be % gold, please.\"\n\n\"";
static constexpr const char *msg_innPickupDied = "Thy friend has died, by the way.\"\n";
static constexpr const char *msg_innPickupEnjoy = "I hope thou hast found thy stay enjoyable,\"\n";
static constexpr const char *msg_innPickupSays = "says $.\n\n";
